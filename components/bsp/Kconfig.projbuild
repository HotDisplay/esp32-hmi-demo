## components/bsp/Kconfig.projbuild
```kconfig
menu "BSP Board Selection"

    choice BSP_BOARD
        prompt "Board Select"

        config BSP_BOARD_H050A29_ESP_STDRGB
            bool "HTM-H050A29-ESP-StdRGB_V0"
            depends on IDF_TARGET_ESP32S3

        config BSP_BOARD_ESP32P4_DEMO_A02
            bool "ESP32P4-DEMO-A02_V0"
            depends on IDF_TARGET_ESP32P4
    endchoice

endmenu
```

## components/display/Kconfig.projbuild
```kconfig
menu "Display Selection"

    choice DISPLAY_IFACE
        prompt "Display Interface"
        default DISPLAY_INTERFACE_RGB

        config DISPLAY_INTERFACE_RGB
            bool "RGB (16-bit parallel)"
            depends on SOC_LCD_RGB_SUPPORTED

        config DISPLAY_INTERFACE_MIPI
            bool "MIPI DSI"
            depends on SOC_MIPI_DSI_SUPPORTED
            help
                MIPI DSI is only available on ESP32-P4.

    endchoice

    if DISPLAY_INTERFACE_RGB

        choice BSP_PANEL_RGB
            prompt "RGB LCD Panel"
            default BSP_PANEL_RGB_H050A29
            help
                SELECT RGB DISPLAY

            config BSP_PANEL_RGB_H021A04
                bool "H021A04 (2.1 inch / 540x540 / AXS15260D)"

            config BSP_PANEL_RGB_H050A29
                bool "H050A29 (5.0 inch / 800x480 / GT911)"

            config BSP_PANEL_RGB_H070B26
                bool "H070B26 (7.0 inch / 1024x600 / GT911)"
        endchoice

    endif

    if DISPLAY_INTERFACE_MIPI

        choice BSP_PANEL_MIPI
            prompt "MIPI DSI LCD Panel"
            default BSP_PANEL_MIPI_H028A29
            help
                SELECT MIPI DSI DISPLAY

            config BSP_PANEL_MIPI_H028A29
                bool "H028A29 (2.8 inch / 540x540)"
            config BSP_PANEL_MIPI_H035B16
                bool "H035B16 (3.5 inch / 640x480)"
            config BSP_PANEL_MIPI_H043A8
                bool "H043A8 (4.3 inch / 480x800)"
            config BSP_PANEL_MIPI_H050A11
                bool "H050A11 (5.0 inch / 480x854 / GT911)"
        endchoice

    endif

    config DISPLAY_USE_TOUCHPAD
        bool "Display Use Touch Panel"
        default n

endmenu
```

## components/gui/Kconfig.projbuild
```kconfig
menu "CSI Camera Demo"
    config GUI_CSI_CAMERA
        bool "Enable CSI camera preview"
        depends on IDF_TARGET_ESP32P4 && SPIRAM
        default y
        select ESP_VIDEO_ENABLE_MIPI_CSI_VIDEO_DEVICE
        select ESP_VIDEO_ENABLE_ISP_VIDEO_DEVICE
        select ESP_VIDEO_ENABLE_ISP_PIPELINE_CONTROLLER
        select ESP_MM_CACHE_MSYNC_C2M_CHUNKED_OPS if DISPLAY_INTERFACE_RGB
        # CSI preview uses no H.264 codec; omit esp_video's optional codec dependency.
        select ESP_VIDEO_USE_CUSTOMIZED_ESP_H264_VERSION
        select CAMERA_SC2336
        select CAMERA_SC2336_AUTO_DETECT_MIPI_INTERFACE_SENSOR
        select CAMERA_OV5647
        select CAMERA_OV5647_AUTO_DETECT_MIPI_INTERFACE_SENSOR
        help
            Preview the official EV Board SC2336 or OV5647 CSI camera.
            The DEMO-A02 camera shares I2C0 with touch (SDA27, SCL26).

    config GUI_CSI_CAMERA_USE_PPA
        bool "Use PPA for camera preview scaling"
        depends on GUI_CSI_CAMERA
        default y if DISPLAY_INTERFACE_MIPI
        default n
        help
            Use hardware scaling for MIPI displays. RGB uses CPU scaling
            by default to isolate PPA cache/DMA interaction with RGB scanout.
            Both paths keep the same preview size and frame rate limit.

    config GUI_CSI_CAMERA_RGB_DIRECT_DMA
        bool "Use direct RGB DMA (diagnostic)"
        depends on GUI_CSI_CAMERA && DISPLAY_INTERFACE_RGB && !DISPLAY_TEST_DEMO
        default n
        help
            Scan PSRAM frame buffers directly instead of filling RGB bounce
            buffers in interrupts. Use this to isolate RGB/CSI contention.
            IDF 6.0.0 and esp_lvgl_port 2.9.0 use a conservative two-VSYNC
            wait before reusing a frame buffer; GUI frame rate is reduced.
endmenu

config ESP_MM_CACHE_MSYNC_C2M_CHUNKED_OPS_MAX_LEN
    default 0x1000 if GUI_CSI_CAMERA && DISPLAY_INTERFACE_RGB
```

## components/panel/Kconfig.projbuild
```kconfig
menu "BSP Panel Selection"

    choice BSP_PANEL
        prompt "LCD Panel (timing + touch)"
        default BSP_PANEL_H050A29

        config BSP_PANEL_H050A29
            bool "H050A29 (5.0 inch / 800x480 / GT911)"

        config BSP_PANEL_H070B26
            bool "H070B26 (7.0 inch / 1024x600 / GT911)"
    endchoice

endmenu
```

## components/touch/Kconfig.projbuild
```kconfig
menu "Touch Selection"

    config DISPLAY_USE_TOUCHPAD
        bool "Enable Touch Panel"
        default n
        help
            Enable touch independently of the selected display panel.
            Native LCD test mode does not initialize touch.

    choice BSP_TOUCH_CONTROLLER
        prompt "Touch Controller"
        depends on DISPLAY_USE_TOUCHPAD
        default BSP_TOUCH_GT911
        help
            Select the driver for the touch controller connected to the board.
            Changing the display panel does not change this selection.

        config BSP_TOUCH_GT911
            bool "GT911"

        config BSP_TOUCH_AXS15260D
            bool "AXS15260D"
    endchoice

    config BSP_TOUCH_NONE
        bool
        default y if !DISPLAY_USE_TOUCHPAD

endmenu
```

## main/Kconfig.projbuild
```kconfig
# @file Kconfig.projbuild
# @brief 选择上电原生显示测试，或进入带手动测试入口的 HMI。
#
# @copyright Copyright (c) 2026 Hot Display Technology Co.,Ltd
# @author Lee
# @date 2026-10-19

menu "Display Test Demo"
    config DISPLAY_TEST_DEMO
        bool "Run native LCD test instead of LVGL"
        default n
        help
            When enabled, run the native LCD test immediately at boot and
            skip the HMI GUI. When disabled, start the HMI; its Display Test
            application can be started manually with the Start Test button.
            Loop red, green, blue, white, 16 grayscale bands and
            an optional image, one second each. Touch and LVGL are not started.
            Grayscale bands are vertical on landscape panels and horizontal
            on portrait panels, determined by the selected panel resolution.
            Put test.png, test.jpg or test.bmp in main/images before building.
endmenu
```

## sdkconfig.defaults
```kconfig
CONFIG_LV_CONF_SKIP=y
CONFIG_LV_USE_OBSERVER=y
CONFIG_LV_USE_SYSMON=y
CONFIG_LV_DEF_REFR_PERIOD=33
CONFIG_LV_USE_PERF_MONITOR=y
CONFIG_LV_USE_DEMO_WIDGETS=y

CONFIG_PARTITION_TABLE_CUSTOM=y
CONFIG_ESPTOOLPY_FLASHSIZE_8MB=y
```
